## boards/arm/arnew_uncle2040/Kconfig.board
```kconfig
# Copyright (c) 2021 Yonatan Schachter
# SPDX-License-Identifier: Apache-2.0

config BOARD_ARNEW_UNCLE2040
	bool "ArneW Uncle 2040"
	depends on SOC_RP2040
```

## boards/arm/arnew_uncle2040/Kconfig.defconfig
```kconfig
# Copyright (c) 2021 Yonatan Schachter
# SPDX-License-Identifier: Apache-2.0

if BOARD_ARNEW_UNCLE2040

config BOARD
	default "arnew_uncle2040" if BOARD_ARNEW_UNCLE2040

config RP2_FLASH_W25Q080
	default y

if I2C_DW

config I2C_DW_CLOCK_SPEED
	default 125

endif #I2C_DW

config USB_SELF_POWERED
	default n

endif # BOARD_ARNEW_UNCLE2040
```

## boards/shields/bob/Kconfig.defconfig
```kconfig
# Copyright (c) 2021 The ZMK Contributors
# SPDX-License-Identifier: MIT

if SHIELD_BOB

config ZMK_KEYBOARD_NAME
    default "Bob"

endif
```

## boards/shields/bob/boards/particle_argon.conf
```kconfig
#CONFIG_GPIO_MCP23XXX=y
CONFIG_I2C=y
CONFIG_ZMK_USB=y
CONFIG_ZMK_BLE=y

CONFIG_ZMK_KSCAN_MATRIX_POLLING=y

CONFIG_USE_DT_CODE_PARTITION=y
CONFIG_BUILD_OUTPUT_UF2=y
CONFIG_BUILD_OUTPUT_HEX=y


CONFIG_MPU_ALLOW_FLASH_WRITE=y
CONFIG_NVS=y
CONFIG_SETTINGS_NVS=y
CONFIG_FLASH=y
CONFIG_FLASH_PAGE_LAYOUT=y
CONFIG_FLASH_MAP=y
```
